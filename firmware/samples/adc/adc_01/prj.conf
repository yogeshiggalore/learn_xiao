## CMakeLists.txt
```
cmake_minimum_required(VERSION 3.20.0)
find_package(Zephyr REQUIRED HINTS $ENV{ZEPHYR_BASE})

project(adc_01)

target_sources(app PRIVATE src/main.c)
```

## prj.conf
```kconfig
CONFIG_GPIO=y
CONFIG_ADC=y
CONFIG_ADC_NRFX_SAADC=y
CONFIG_PRINTK=y
CONFIG_STDOUT_CONSOLE=y
```

## boards/xiao_mg24.overlay
```dts
/ {
    gpiocustom {
        compatible = "gpio-keys";
        appled0: appled_0 {
            gpios = <&gpioa 7 GPIO_ACTIVE_LOW>;
            label = "app led 0";
        };
    };

    aliases {
        appled0 = &appled0;
    };
};
```

## boards/xiao_nrf54l15_nrf54l15_cpuapp.overlay
```dts
/ {
    zephyr,user {
        /* Link to the ADC controller and the channel index (1) Pin P1.05 */
        io-channels = <&adc 0>;
    };
};

&adc {
    status = "okay";
    #address-cells = <1>;
    #size-cells = <0>;

    channel@1 {
        reg = <1>;
        zephyr,gain = "ADC_GAIN_1_4";
        zephyr,reference = "ADC_REF_INTERNAL";
        zephyr,acquisition-time = <ADC_ACQ_TIME_DEFAULT>;
        zephyr,input-positive = <NRF_SAADC_AIN0>;
        zephyr,resolution = <14>;
    };
};
```

## src/main.c
```c
#include <zephyr/kernel.h>
#include <zephyr/drivers/adc.h>
#include <zephyr/logging/log.h>


static const struct adc_dt_spec adc_chan0 = ADC_DT_SPEC_GET(DT_PATH(zephyr_user));
int main(void)
{
    int err;
    int16_t buf;
    struct adc_sequence sequence = 
	{
        .buffer = &buf,
        .buffer_size = sizeof(buf),
    };

    /* Check if the ADC device is ready */
    if (!adc_is_ready_dt(&adc_chan0)) {
        printk("ADC device not ready\n");
        return 0;
    }

    /* Setup the channel using the DT spec */
    err = adc_channel_setup_dt(&adc_chan0);
    if (err < 0) {
        printk("Could not setup channel (%d)\n", err);
        return 0;
    }

    while (1) {
        /* Initialize sequence from devicetree specs (resolution, etc.) */
        err = adc_sequence_init_dt(&adc_chan0, &sequence);
        if (err < 0) {
            printk("Sequence init failed (%d)\n", err);
            continue;
        }

        /* Read the raw value */
        err = adc_read(adc_chan0.dev, &sequence);
        if (err == 0) {
            int32_t val_mv = buf;
            /* Convert raw value to millivolts using the DT spec */
            err = adc_raw_to_millivolts_dt(&adc_chan0, &val_mv);
            if (err < 0) {
                printk("Raw: %d (mV conversion not supported)\n", buf);
            } else {
                printk("Raw: %d, Voltage: %d mV\n", buf, val_mv);
            }
        } else {
            printk("ADC read failed (%d)\n", err);
        }

        k_msleep(1000);
    }

	return 0;
}
```
