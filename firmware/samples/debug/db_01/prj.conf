## CMakeLists.txt
```
cmake_minimum_required(VERSION 3.20.0)
find_package(Zephyr REQUIRED HINTS $ENV{ZEPHYR_BASE})

project(db_01)

target_sources(app PRIVATE src/main.c)
```

## prj.conf
```kconfig
CONFIG_GPIO=y
CONFIG_ASSERT=y

CONFIG_DEBUG=y
CONFIG_DEBUG_OPTIMIZATIONS=y
CONFIG_NO_OPTIMIZATIONS=y
```

## boards/cy8cproto_063_ble.overlay
```dts
/ {
    gpiocustom {
        compatible = "gpio-keys";
        appled0: appled_0 {
            gpios = <&gpio_prt6 3 GPIO_ACTIVE_LOW>;
            label = "app led 0";
        };
    };

    aliases {
        appled0 = &appled0;
    };
};
```

## boards/xiao_esp32s3_appcpu.overlay
```dts
/ {
    gpiocustom {
        compatible = "gpio-leds";
        appled0: appled_0 {
            gpios = <&gpio0 21 GPIO_ACTIVE_LOW>;
            label = "app led 0";
        };
    };

    aliases {
        appled0 = &appled0;
    };
};
```

## src/main.c
```c
/* include kernel components */
#include <zephyr/kernel.h>

/* include device drivers */
#include <zephyr/drivers/gpio.h>

#define LED_SLEEP_TIME_MS   1000

/* the device tree indentifier for the appled0 node */
#define LED0_NODE DT_ALIAS(appled0)

/* get devicetree spec for led0 node */
static const struct gpio_dt_spec led = GPIO_DT_SPEC_GET(LED0_NODE, gpios);

struct db_params {
	uint32_t param1;
	uint32_t param2;
};

static volatile uint32_t cntr;
struct db_params params = {
	.param1 = 10,
	.param2 = 20,
};

int main(void)
{
	int ret;

	cntr=0;

	/* check if the led port is ready */
	if (!device_is_ready(led.port))
	{
		return -1;
	}

	/* configure the led pin */
	ret = gpio_pin_configure_dt(&led, GPIO_OUTPUT_ACTIVE);
	if (ret < 0)
	{
		return -1;
	}
	/* blink the led */
	while (1)
	{
		/* toggle the led pin */
		gpio_pin_toggle(led.port, led.pin);
		/* sleep for some time */
		k_msleep(LED_SLEEP_TIME_MS);
		cntr++;
		printk("cntr:%d\n", cntr);
		params.param1 += 1;
		params.param2 += 2;
	}

    return 0;
}
```
