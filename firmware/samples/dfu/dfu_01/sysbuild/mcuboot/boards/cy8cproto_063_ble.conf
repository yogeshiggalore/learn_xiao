## firmware/samples/dfu/dfu_01/sysbuild/mcuboot/boards/cy8cproto_063_ble.conf
```kconfig
# --- Fix FLASH_MAP/FLASH_HAS_DRIVER_ENABLED fallout (enable flash support) ---
CONFIG_FLASH=y
CONFIG_FLASH_MAP=y
CONFIG_FLASH_PAGE_LAYOUT=y

# --- Fix: BOOT_MAX_IMG_SECTORS assigned but ignored because AUTO is on ---
CONFIG_BOOT_MAX_IMG_SECTORS_AUTO=n
CONFIG_BOOT_MAX_IMG_SECTORS=256

# --- Fix: REGULATOR_FIXED_INIT_PRIORITY assigned but regulator not enabled ---
CONFIG_REGULATOR=y
CONFIG_REGULATOR_FIXED=y

# --- Fix: overwrite-only choice selected but no final choice selected ---
# Use a widely-supported MCUboot mode for compatibility
CONFIG_MCUBOOT_BOOTLOADER_MODE_SWAP_USING_SCRATCH=y

# Optional: avoid MCUboot device settings path if it still triggers flash-map issues
# CONFIG_MCUBOOT_DEVICE_SETTINGS=n
```

## firmware/samples/dfu/dfu_01/sysbuild/mcuboot/boards/xiao_esp32s3_procpu_sense.conf
```kconfig
# # --- Make MCUboot tiny (ESP32-S3 IRAM is tight) ---
CONFIG_LOG=n
CONFIG_PRINTK=n
CONFIG_CONSOLE=n
CONFIG_UART_CONSOLE=n
CONFIG_SERIAL=n

CONFIG_BOOT_BANNER=n
CONFIG_CBPRINTF_COMPLETE=n
CONFIG_CBPRINTF_FP_SUPPORT=n

# # --- Avoid heap/malloc expectations in bootloader ---
CONFIG_MINIMAL_LIBC=n
CONFIG_PICOLIBC=n
CONFIG_COMMON_LIBC_MALLOC=n
CONFIG_HEAP_MEM_POOL_SIZE=0

CONFIG_COMPILER_OPT="-Oz"
CONFIG_SIZE_OPTIMIZATIONS=y

CONFIG_STACK_CANARIES=n
CONFIG_STACK_SENTINEL=n
CONFIG_HW_STACK_PROTECTION=n
CONFIG_FORTIFY_SOURCE_NONE=n

# # Reduce logging/formatting even more
# CONFIG_CBPRINTF_NANO=y
#CONFIG_CBPRINTF_COMPLETE=n
CONFIG_DEBUG=n

# # Keep interrupt + timing minimal
CONFIG_TIMING_FUNCTIONS=n
CONFIG_ASSERT=n

CONFIG_MCUBOOT_LOG_LEVEL_INF=n
CONFIG_LOG=n
CONFIG_PRINTK=n
CONFIG_CBPRINTF_NANO=n
CONFIG_CBPRINTF_COMPLETE=n

CONFIG_USERSPACE=n
CONFIG_TICKLESS_KERNEL=n
CONFIG_MULTITHREADING=n
#CONFIG_BOOT_MAX_IMG_SECTORS_AUTO=y

CONFIG_MAIN_STACK_SIZE=12288

CONFIG_MINIMAL_LIBC=n
CONFIG_PICOLIBC=n

CONFIG_EXCEPTION_STACK_TRACE=n
CONFIG_DEBUG_OPTIMIZATIONS=n
CONFIG_XTENSA_ENABLE_BACKTRACE=n

CONFIG_LOG_BACKEND_UART=n
CONFIG_LOG_BACKEND_RTT=n
CONFIG_RTT_CONSOLE=n
```

## firmware/samples/dfu/dfu_01/sysbuild/mcuboot/boards/xiao_mg24.conf
```kconfig
CONFIG_PRINTK=y
CONFIG_LOG=y
CONFIG_MCUBOOT_LOG_LEVEL_INF=y
CONFIG_SERIAL=y
CONFIG_CONSOLE=y

CONFIG_UART_CONSOLE=y

CONFIG_MULTITHREADING=y

CONFIG_BOOT_MAX_IMG_SECTORS=256

CONFIG_MAIN_STACK_SIZE=16384
```

## firmware/samples/dfu/dfu_01/sysbuild/mcuboot/boards/xiao_nrf54l15_nrf54l15_cpuapp.conf
```kconfig
CONFIG_PRINTK=y
CONFIG_LOG=y
CONFIG_MCUBOOT_LOG_LEVEL_INF=y
CONFIG_SERIAL=y
CONFIG_CONSOLE=y

CONFIG_UART_CONSOLE=y

CONFIG_FPROTECT=n
CONFIG_PM_EXTERNAL_FLASH_MCUBOOT_SECONDARY=n
CONFIG_NORDIC_QSPI_NOR=n

CONFIG_MULTITHREADING=y
CONFIG_BOOT_MAX_IMG_SECTORS=256

CONFIG_MAIN_STACK_SIZE=16384
```
