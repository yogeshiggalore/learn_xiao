/ {
    gpiocustom {
        compatible = "gpio-keys";
        appled0: appled_0 {
            gpios = <&porta 17 GPIO_ACTIVE_LOW>;
            label = "app led 0";
        };
    };

    aliases {
        appled0 = &appled0;
    };
};