/ {
    gpiocustom {
        compatible = "gpio-keys";
        appled0: appled_0 {
            gpios = <&gpio1 22 GPIO_ACTIVE_HIGH>;
            label = "app led 0";
        };
    };

    aliases {
        appled0 = &appled0;
    };
};